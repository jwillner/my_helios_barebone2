## build/Kconfig/Kconfig.shield
```kconfig
osource "/Users/jw/Helios-Firmware/my_helios_barebone2/boards/shields/*/Kconfig.shield"
osource "/opt/nordic/ncs/v2.4.0/nrf/boards/shields/*/Kconfig.shield"
```

## build/Kconfig/Kconfig.shield.defconfig
```kconfig
osource "/Users/jw/Helios-Firmware/my_helios_barebone2/boards/shields/*/Kconfig.defconfig"
osource "/opt/nordic/ncs/v2.4.0/nrf/boards/shields/*/Kconfig.defconfig"
```
